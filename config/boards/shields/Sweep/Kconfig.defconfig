## config/boards/shields/Sweep/Kconfig.defconfig
```kconfig
# Copyright (c) 2021 The ZMK Contributors
# SPDX-License-Identifier: MIT

if SHIELD_SWEEP

config ZMK_KEYBOARD_NAME
    default "Nice Test"

endif
```

## config/boards/shields/Sweep/Kconfig.shield
```kconfig
# Copyright (c) 2021 The ZMK Contributors
# SPDX-License-Identifier: MIT

config SHIELD_SWEEP_LEFT
    def_bool $(shields_list_contains,Sweep_left)

config SHIELD_SWEEP_RIGHT
    def_bool $(shields_list_contains,Sweep_right)
```
